## app/boards/shields/embodi_ctrlr/Kconfig.defconfig
```kconfig
# Copyright (c) 2020 The ZMK Contributors
# SPDX-License-Identifier: MIT

if SHIELD_EMBODI_CTRLR_LEFT

	config ZMK_KEYBOARD_NAME
		default "Embodi CtrlR"

	config ZMK_SPLIT_ROLE_CENTRAL
		default y

endif # SHIELD_EMBODI_CTRLR_LEFT


if SHIELD_EMBODI_CTRLR_LEFT || SHIELD_EMBODI_CTRLR_RIGHT

	config ZMK_SPLIT
		default y
	
	config ZMK_BLE
		default y
 
endif # SHIELD_EMBODI_CTRLR_LEFT || SHIELD_EMBODI_CTRLR_RIGHT
```

## app/boards/shields/embodi_ctrlr/Kconfig.shield
```kconfig
# Copyright (c) 2020 The ZMK Contributors
# SPDX-License-Identifier: MIT

config SHIELD_EMBODI_CTRLR_LEFT
	def_bool $(shields_list_contains,embodi_ctrlr_left)

config SHIELD_EMBODI_CTRLR_RIGHT
	def_bool $(shields_list_contains,embodi_ctrlr_right)
```
